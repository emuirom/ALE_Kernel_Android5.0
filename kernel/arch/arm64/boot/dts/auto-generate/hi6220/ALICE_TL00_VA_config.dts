/*
 *  Copyright (C) 2014 Hisilicon Ltd.
 *  Author: Bintian Wang <bintian.wang@huawei.com>
 *
 *  This program is free software; you can redistribute it and/or modify
 *  it under the terms of the GNU General Public License version 2 as
 *  publishhed by the Free Software Foundation.
 */

/dts-v1/;
/include/ "fastboot.dtsi"
/include/ "ALICE_UL00_VA_config.dtsi"
/include/ "ALICE_TL00_VA_pin.dtsi"
/include/ "ALICE_TL00_VA_gpio_logic.dtsi"
/include/ "ALICE_TL00_VA_pmic.dtsi"
/include/ "ALICE_TL00_VA_charger.dtsi"
/ {
    hisi,boardid = <0 7 0 7>;
    hisi,boardname = "ALICE_TL00_VA";
	hisi,platform_num = <2>;
	hisi,provider0 = "HuaweiB";
	hisi,sub_platform_info0 = "V8R2";
	hisi,provider1 = "HuaweiB";
	hisi,sub_platform_info1 = "HI6361";
    hisi,modem_id = <0x3DD52500>;
    hisi,product_name = "ALICE_TL00";

    boardinfo{
        factory_product_name = "HL2ALICEMAA";
        normal_product_name = "ALE-TL00";
    };
    hi1101-power {
        wifi_sdio_rw = "SDIO_RW_ALICE_TL00_FEM.bin";
        hisi_cfg_ini_file = "/system/etc/hisi_cfg_alice.ini";
    };
};
