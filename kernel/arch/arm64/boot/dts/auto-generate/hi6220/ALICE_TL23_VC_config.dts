/*
 *  Copyright (C) 2014 Hisilicon Ltd.
 *  Author: Bintian Wang <bintian.wang@huawei.com>
 *
 *  This program is free software; you can redistribute it and/or modify
 *  it under the terms of the GNU General Public License version 2 as
 *  publishhed by the Free Software Foundation.
 */

/dts-v1/;
/include/ "./cherry_plus_r2/hi6210_mipi_boe_NT35521_5P0_3lane.dtsi"
/include/ "./cherry_plus_r2/hi6220_mipi_boe_NT35521S_5P0_3lane.dtsi"
/include/ "./cherry_plus_r2/hi6220_mipi_cmi_otm1283a_3lane.dtsi"
/include/ "fastboot.dtsi"
/include/ "ALICE_UL00_VB_config.dtsi"
/include/ "ALICE_TL23_VC_pin.dtsi"
/include/ "ALICE_TL23_VC_gpio_logic.dtsi"
/include/ "ALICE_TL23_VC_pmic.dtsi"
/include/ "ALICE_TL23_VC_charger.dtsi"
/ {
    hisi,boardid = <0 7 4 9>;
    hisi,boardname = "ALICE_TL23_VC";
	hisi,platform_num = <2>;
	hisi,provider0 = "HuaweiB";
	hisi,sub_platform_info0 = "V8R2";
	hisi,provider1 = "HuaweiB";
	hisi,sub_platform_info1 = "HI6361";
    hisi,modem_id = <0x3DB54D00>;
    hisi,product_name = "ALICE_TL23";

    boardinfo{
        factory_product_name = "HL3ALICEMBA";
        normal_product_name = "ALE-L23";
    };
    hi1101-power {
        wifi_sdio_rw = "SDIO_RW_ALICE_TL23_FEM.bin";
        hisi_cfg_ini_file = "/system/etc/hisi_cfg_alice.ini";
    };

    fb@f4100000 {
        compatible = "hisilicon,hi6210-fb";
        product_id = <0x40>;
    };

};
