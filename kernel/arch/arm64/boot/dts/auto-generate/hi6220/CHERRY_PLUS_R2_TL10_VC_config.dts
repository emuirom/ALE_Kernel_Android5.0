/*
 *  Copyright (C) 2014 Hisilicon Ltd.
 *  Author: Bintian Wang <bintian.wang@huawei.com>
 *
 *  This program is free software; you can redistribute it and/or modify
 *  it under the terms of the GNU General Public License version 2 as
 *  publishhed by the Free Software Foundation.
 */

/dts-v1/;
/* NOTE:
 * The last reserved memory base is used in fastboot
 * Which should be the least reseve value
 */
/include/ "fastboot.dtsi"
/include/ "CHERRY_PLUS_R2_TL10_VB_config.dtsi"
/include/ "CHERRY_PLUS_R2_TL10_VC_pin.dtsi"
/include/ "CHERRY_PLUS_R2_TL10_VC_gpio_logic.dtsi"
/include/ "CHERRY_PLUS_R2_TL10_VC_pmic.dtsi"
/include/ "CHERRY_PLUS_R2_TL10_VC_charger.dtsi"
/ {
    hisi,boardid = <0 7 5 2>;
    hisi,boardname = "CHERRY_PLUS_R2_TL10_VC";
    hisi,modem_id = <0x3DD52100>;
};
