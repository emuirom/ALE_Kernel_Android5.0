/*
 *  Copyright (C) 2014 Hisilicon Ltd.
 *  Author: Bintian Wang <bintian.wang@huawei.com>
 *
 *  This program is free software; you can redistribute it and/or modify
 *  it under the terms of the GNU General Public License version 2 as
 *  publishhed by the Free Software Foundation.
 */

/dts-v1/;
/memreserve/ 0x3e700000 0x01900000;/* Framebuffer 25M */
/memreserve/ 0x3c700000 0x02000000;/* SecureOS 32M */
/include/ "fastboot.dtsi"
/include/ "CHERRY_PRO_TL10_VA_config.dtsi"
/include/ "CHERRY_PRO_TL00_VA_pin.dtsi"
/include/ "CHERRY_PRO_TL00_VA_gpio_logic.dtsi"
/include/ "CHERRY_PRO_TL00_VA_pmic.dtsi"
/include/ "CHERRY_PRO_TL00_VA_charger.dtsi"
/ {
    hisi,boardid = <0 7 8 2>;
    hisi,boardname = "CHERRY_PRO_TL00_VA";
    hisi,modem_id = <0x3DD52900>;
    hisi,product_name = "CHERRY_PRO_TL00";

    boardinfo{
        factory_product_name = "HL0CHEPROTLTM";
        normal_product_name = "CHE-TL00";
    };

	hi1101-power {
		rssi_fix = <2>;
    };
};
